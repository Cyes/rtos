#include "st7789.h"
#include "bsp.h"





const unsigned char ascii_1608[][16]={
{0x00,0x00,0x00,0x00,0x00,0x00,0x00,0x00,0x00,0x00,0x00,0x00,0x00,0x00,0x00,0x00},/*" ",0*/
{0x00,0x00,0x00,0x08,0x08,0x08,0x08,0x08,0x08,0x08,0x00,0x00,0x18,0x18,0x00,0x00},/*"!",1*/
{0x00,0x48,0x6C,0x24,0x12,0x00,0x00,0x00,0x00,0x00,0x00,0x00,0x00,0x00,0x00,0x00},/*""",2*/
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{0x00,0x7E,0x7E,0x7E,0x7E,0x7E,0x7E,0x7E,0x7E,0x7E,0x7E,0x7E,0x7E,0x7E,0x7E,0x00},/*"?",95*/

}; 








void LCD_WR_REG(uint8_t dat)
{
	SET_DC_PIN(0);
	spix_readwrite(&dat,1);
	SET_DC_PIN(1);
}


uint16_t bswap_16(uint16_t a) 
{
	return ((a >> 8) & 0xFF) | ((a << 8) & 0xFF00);
} 



void	LCD_WR_DATA(uint16_t dat)
{
	dat = bswap_16(dat);
	spix_readwrite(&dat,2);
}


void LCD_WR_DATA8(uint8_t dat)
{
	spix_readwrite(&dat,1);
}




void lcd_window(uint16_t x1,uint16_t y1,uint16_t x2,uint16_t y2)
{
		LCD_WR_REG(0x2a);
		LCD_WR_DATA(x1+40);
		LCD_WR_DATA(x2+40);
		LCD_WR_REG(0x2b);
		LCD_WR_DATA(y1+53);
		LCD_WR_DATA(y2+53);
		LCD_WR_REG(0x2c);
}


void lcd_fill(uint16_t xsta,uint16_t ysta,uint16_t xend,uint16_t yend,uint16_t color)
{          
	uint16_t i,j; 
	lcd_window(xsta,ysta,xend-1,yend-1); 
	
	for(i=ysta;i<yend;i++){													   	 	
		for(j=xsta;j<xend;j++){
			LCD_WR_DATA(color);
		}
	} 					  	    
}



void lcd_drawchar(uint16_t x,uint16_t y,uint8_t num,uint16_t fc,uint16_t bc)
{
	uint8_t t,m=0;
	num=num-' ';
	lcd_window(x,y,x+8-1,y+16-1);
	for(int i=0;i<16;i++)
	{ 
		for(int t=0;t<8;t++)
		{
				if(ascii_1608[num][i]&(0x01<<t))LCD_WR_DATA(fc);
				else LCD_WR_DATA(bc);
				m++;
				if(m%8==0){
					m=0;
					break;
				}			
		}
	}   	 	  
}


void lcd_drawpix_buffer(uint16_t x,uint16_t y,uint16_t color)
{
    #define OFFSET_X  4
    #define OFFSET_Y  4
    static uint8_t symbal[][16] = {0x00,0x7E,0x7E,0x7E,0x7E,0x7E,0x7E,0x7E,0x7E,0x7E,0x7E,0x7E,0x7E,0x7E,0x7E,0x00};
	uint16_t font_color = bswap_16(color);
	uint16_t back_color = bswap_16(WHITE);
	static uint16_t charbuf[OFFSET_X *OFFSET_Y];
	
	lcd_window(x,y,x+OFFSET_X-1,y+OFFSET_Y-1);
	char *p = (char *)&symbal[0];

	
	for(int i=0;i<OFFSET_Y;i++){ 
			for(int t=0;t<OFFSET_X;t++){
				if(*p == 0){
					charbuf[t + (i * OFFSET_X)] = back_color ;
				}else{
					charbuf[t + (i * OFFSET_X)] = (*p &(1<<t)) ? font_color : back_color ; 
				}				
			}		
		p++;
	}

	spix_readwrite(charbuf,OFFSET_X * OFFSET_Y * 2);
	
}
void lcd_drawchar_buffer(uint16_t x,uint16_t y,uint8_t data,uint16_t fc,uint16_t bc)
{
	uint16_t font_color = bswap_16(fc);
	uint16_t back_color = bswap_16(bc);
	static uint16_t charbuf[128];
	
	lcd_window(x,y,x+8-1,y+16-1);
	char *p = (char *)&ascii_1608[data - ' '];
	if(data == ' '){
		for(int i=0;i<128;i++){
			charbuf[i] = back_color;
		}
		spix_readwrite(charbuf,256);
		return ;
	}
	
	for(int i=0;i<16;i++){ 
			for(int t=0;t<8;t++){
				if(*p == 0){
					charbuf[t + (i<<3)] = back_color ;
				}else{
					charbuf[t + (i<<3)] = (*p &(1<<t)) ? font_color : back_color ; 
				}				
			}		
		p++;
	}

	spix_readwrite(charbuf,256);
	
}

void lcd_drawstring(int x, int y, char *p, int fc, int bc)
{
	while(*p != 0)
	{
		lcd_drawchar_buffer(x,y,*p++,fc,bc);
		x += 8;
		if(*p == '\n'){
			p ++ ;
			x = 0;
			y += 16;
		}
	}
}


void delay(int tick)
{
		while(tick--);
}


void lcd_init(void)
{
	
	SET_RES_PIN(0);
	delay(10000);
	SET_RES_PIN(1);

	LCD_WR_REG(0x11); 
	LCD_WR_REG(0x36); 
	LCD_WR_DATA8(0x70);//
	LCD_WR_REG(0x3A);
	LCD_WR_DATA8(0x05);

	LCD_WR_REG(0xB2);
	LCD_WR_DATA8(0x0C);
	LCD_WR_DATA8(0x0C);
	LCD_WR_DATA8(0x00);
	LCD_WR_DATA8(0x33);
	LCD_WR_DATA8(0x33); 

	LCD_WR_REG(0xB7); 
	LCD_WR_DATA8(0x35);  

	LCD_WR_REG(0xBB);
	LCD_WR_DATA8(0x19);

	LCD_WR_REG(0xC0);
	LCD_WR_DATA8(0x2C);

	LCD_WR_REG(0xC2);
	LCD_WR_DATA8(0x01);

	LCD_WR_REG(0xC3);
	LCD_WR_DATA8(0x12);   

	LCD_WR_REG(0xC4);
	LCD_WR_DATA8(0x20);  

	LCD_WR_REG(0xC6); 
	LCD_WR_DATA8(0x0F);    

	LCD_WR_REG(0xD0); 
	LCD_WR_DATA8(0xA4);
	LCD_WR_DATA8(0xA1);

	LCD_WR_REG(0xE0);
	LCD_WR_DATA8(0xD0);
	LCD_WR_DATA8(0x04);
	LCD_WR_DATA8(0x0D);
	LCD_WR_DATA8(0x11);
	LCD_WR_DATA8(0x13);
	LCD_WR_DATA8(0x2B);
	LCD_WR_DATA8(0x3F);
	LCD_WR_DATA8(0x54);
	LCD_WR_DATA8(0x4C);
	LCD_WR_DATA8(0x18);
	LCD_WR_DATA8(0x0D);
	LCD_WR_DATA8(0x0B);
	LCD_WR_DATA8(0x1F);
	LCD_WR_DATA8(0x23);

	LCD_WR_REG(0xE1);
	LCD_WR_DATA8(0xD0);
	LCD_WR_DATA8(0x04);
	LCD_WR_DATA8(0x0C);
	LCD_WR_DATA8(0x11);
	LCD_WR_DATA8(0x13);
	LCD_WR_DATA8(0x2C);
	LCD_WR_DATA8(0x3F);
	LCD_WR_DATA8(0x44);
	LCD_WR_DATA8(0x51);
	LCD_WR_DATA8(0x2F);
	LCD_WR_DATA8(0x1F);
	LCD_WR_DATA8(0x1F);
	LCD_WR_DATA8(0x20);
	LCD_WR_DATA8(0x23);

	LCD_WR_REG(0x21); 

	LCD_WR_REG(0x29); 
	
	lcd_fill(0,0,LCD_WIDTH,LCD_HIGHT,WHITE);
	
	SET_BLK_PIN(1);

}

